// SPDX-License-Identifier: GPL-2.0
#include "arm/bcm2711-rpi-4-b.dts"

&spi0 {
	status = "okay";

	slb9670: slb9670@1 {
		compatible = "infineon,slb9670";
		reg = <1>;	/* CE1 */
		#address-cells = <1>;
		#size-cells = <0>;
		spi-max-frequency = <32000000>;
		status = "okay";
	};
};

&spidev1 {
	status = "disabled";
};

